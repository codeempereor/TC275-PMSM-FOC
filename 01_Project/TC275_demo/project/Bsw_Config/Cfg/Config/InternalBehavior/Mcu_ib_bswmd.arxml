AUTOSAR XML (schema 00046)
package /AURIX/Mcu_ib_bswmd/BswModuleDescriptions
  bsw module description Mcu
    bsw internal behavior McuBehavior
