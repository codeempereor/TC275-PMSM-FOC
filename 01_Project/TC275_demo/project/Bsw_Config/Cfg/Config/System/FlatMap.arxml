AUTOSAR XML (schema 00046)
package /COM/VECTOR/CFG/WORKFLOW/SYSDESC/SYNC
  flat map FLATMAP
    flat instance descriptor IoHwAb: upstream-reference=EcuSwComposition.IoHwAb, ecu-extract-reference=COMPOSITIONTYPE.IoHwAb
