AUTOSAR XML (schema 00046)
package /MICROSAR/BswM_swc
  4 x mode declaration group:
    ESH_Mode: initial-mode=STARTUP
      5 x mode:
        STARTUP
        RUN
        POSTRUN
        WAKEUP
        SHUTDOWN
    ESH_RunRequest: initial-mode=RELEASED
      mode RELEASED
      mode REQUESTED
    ModeDecl_ComFault_State: initial-mode=ComFaultPreCond_FAIL
      mode ComFaultPreCond_PASS
      mode ComFaultPreCond_FAIL
    ModeDecl_ComFault_State_WithKL15: initial-mode=ComFaultPreCondWithKL15_FAIL
      mode ComFaultPreCondWithKL15_FAIL
      mode ComFaultPreCondWithKL15_PASS
  data type mapping set BswMMappingSet  # Contains Mapping for ModeDeclarations Groups which are provided by BswM.
    mode-request-type-maps:
      implementation-data-type=BswM_ESH_Mode, mode-group=ESH_Mode
      implementation-data-type=BswM_ESH_RunRequest, mode-group=ESH_RunRequest
      implementation-data-type=BswM_ModeDecl_ComFault_State, mode-group=ModeDecl_ComFault_State
      implementation-data-type=BswM_ModeDecl_ComFault_State_WithKL15, mode-group=ModeDecl_ComFault_State_WithKL15
package /MICROSAR/BswM_swc/ComponentTypes
  service sw component type BswM: category=SERVICE_COMPONENT
    behavior BswMInternalBehavior: data-type-mapping=BswMMappingSet, handle-termination-and-restart=NO-SUPPORT, included-data-type-set=data-type=[BswM_ESH_Mode, BswM_ESH_RunRequest, BswM_ModeDecl_ComFault_State, BswM_ModeDecl_ComFault_State_WithKL15]
      timing event Timer_BswM_MainFunction: start-on-event=BswM_MainFunction, period=0.005
      runnable BswM_MainFunction
  swc implementation BswMImplementation: programming-language=C, behavior=BswMInternalBehavior
package /MICROSAR/BswM_swc/DataTypes
  4 x impl type, all with category=TYPE_REFERENCE, range raw 0..255, implementation-data-type=uint8:
    BswM_ESH_Mode: compu {0=STARTUP, 1=RUN, 2=POSTRUN, 3=WAKEUP, 4=SHUTDOWN}  # Unique value for each user
    BswM_ESH_RunRequest: compu {0=RELEASED, 1=REQUESTED}  # Unique value for each user
    BswM_ModeDecl_ComFault_State: compu {1=ComFaultPreCond_PASS, 0=ComFaultPreCond_FAIL}  # Unique value for each user
    BswM_ModeDecl_ComFault_State_WithKL15: compu {0=ComFaultPreCondWithKL15_FAIL, 1=ComFaultPreCondWithKL15_PASS}  # Unique value for each user
package /MICROSAR/BswM_swc/Interfaces
  mode switch interface BswM_MSI_ESH_Mode: is-service=true, service-kind=BASIC-SOFTWARE-MODE-MANAGER
    mode group BswM_MDGP_ESH_Mode: type=ESH_Mode
  sender receiver interface BswM_SRI_BswM_MSI_ESH_Mode_BswM_MDGP_ESH_Mode: is-service=true, service-kind=BASIC-SOFTWARE-MODE-MANAGER
    data requestedMode: type=BswM_ESH_Mode
  mode switch interface BswM_MSI_ESH_RunRequest: is-service=true, service-kind=BASIC-SOFTWARE-MODE-MANAGER
    mode group BswM_MDGP_ESH_RunRequest: type=ESH_RunRequest
  sender receiver interface BswM_SRI_BswM_MSI_ESH_RunRequest_BswM_MDGP_ESH_RunRequest: is-service=true, service-kind=BASIC-SOFTWARE-MODE-MANAGER
    data requestedMode: type=BswM_ESH_RunRequest
  mode switch interface BswM_MSI_ModeDecl_ComFault_State: is-service=true, service-kind=BASIC-SOFTWARE-MODE-MANAGER
    mode group BswM_MDGP_ModeDecl_ComFault_State: type=ModeDecl_ComFault_State
  sender receiver interface BswM_SRI_BswM_MSI_ModeDecl_ComFault_State_BswM_MDGP_ModeDecl_ComFault_State: is-service=true, service-kind=BASIC-SOFTWARE-MODE-MANAGER
    data requestedMode: type=BswM_ModeDecl_ComFault_State
  mode switch interface BswM_MSI_ModeDecl_ComFault_State_WithKL15: is-service=true, service-kind=BASIC-SOFTWARE-MODE-MANAGER
    mode group BswM_MDGP_ModeDecl_ComFault_State_WithKL15: type=ModeDecl_ComFault_State_WithKL15
  sender receiver interface BswM_SRI_BswM_MSI_ModeDecl_ComFault_State_WithKL15_BswM_MDGP_ModeDecl_ComFault_State_WithKL15: is-service=true, service-kind=BASIC-SOFTWARE-MODE-MANAGER
    data requestedMode: type=BswM_ModeDecl_ComFault_State_WithKL15
