AUTOSAR XML (schema 00046)
package /VehicleProject
  system System
    system mapping System_MPPNG
      data-mappings:
        {signal-group=SG_Sig_Grp_0x210, type-mapping=sender-rec-record-type-mapping=record-element-mappings=[{implementation-record-element=F_Led1_State, system-signal=F_Led1_State}, {implementation-record-element=F_Led2_State, system-signal=F_Led2_State}, {implementation-record-element=F_Led3_State, system-signal=F_Led3_State}, {implementation-record-element=F_Led4_State, system-signal=F_Led4_State}]}
        {signal-group=SG_Sig_Grp_0x211, type-mapping=sender-rec-record-type-mapping=record-element-mappings=[{implementation-record-element=F_Button1_State, system-signal=F_Button1_State}, {implementation-record-element=F_Button2_State, system-signal=F_Button2_State}, {implementation-record-element=F_Button3_State, system-signal=F_Button3_State}, {implementation-record-element=F_Button4_State, system-signal=F_Button4_State}]}
        {signal-group=SG_Sig_Grp_0x212, type-mapping=sender-rec-record-type-mapping=record-element-mappings=[{implementation-record-element=F_PowerMode, system-signal=F_PowerMode}, {implementation-record-element=SupF_Checksum_0x212, system-signal=SupF_Checksum_0x212}, {implementation-record-element=SupF_Counter_0x212, system-signal=SupF_Counter_0x212}]}
        {signal-group=SG_Sig_Grp_0x213, type-mapping=sender-rec-record-type-mapping=sender-rec-record-element-mapping{implementation-record-element=F_AAA_Angle, system-signal=F_AAA_Angle}}
        {signal-group=SG_Sig_Grp_0x214, type-mapping=sender-rec-record-type-mapping=record-element-mappings=[{implementation-record-element=F_Sig_0x214_Used_1, system-signal=F_Sig_0x214_Used_1}, {implementation-record-element=F_Sig_0x214_Used_2, system-signal=F_Sig_0x214_Used_2}, {implementation-record-element=F_Sig_0x214_Used_3, system-signal=F_Sig_0x214_Used_3}, {implementation-record-element=F_Sig_0x214_Used_5, system-signal=F_Sig_0x214_Used_5}]}
        {signal-group=SG_Sig_Grp_0x216, type-mapping=sender-rec-record-type-mapping=record-element-mappings=[{implementation-record-element=F_Meg_E2E_Error, system-signal=F_Meg_E2E_Error}, {implementation-record-element=F_Mes_Lost_Error, system-signal=F_Mes_Lost_Error}]}
        {signal-group=SG_Sig_Grp_0x301, type-mapping=sender-rec-record-type-mapping=record-element-mappings=[{implementation-record-element=D_Button1_Control, system-signal=D_Button1_Control}, {implementation-record-element=D_Button2_Control, system-signal=D_Button2_Control}, {implementation-record-element=D_Button3_Control, system-signal=D_Button3_Control}, {implementation-record-element=D_Button4_Control, system-signal=D_Button4_Control}]}
        {signal-group=SG_Sig_Grp_0x302, type-mapping=sender-rec-record-type-mapping=record-element-mappings=[{implementation-record-element=E_Sig_0x302_Used_1, system-signal=E_Sig_0x302_Used_1}, {implementation-record-element=E_Sig_0x302_Used_2, system-signal=E_Sig_0x302_Used_2}, {implementation-record-element=E_Sig_0x302_Used_3, system-signal=E_Sig_0x302_Used_3}]}
        {signal-group=SG_Sig_Grp_0x304, type-mapping=sender-rec-record-type-mapping=record-element-mappings=[{implementation-record-element=D_Led1_CtrlMode, system-signal=D_Led1_CtrlMode}, {implementation-record-element=D_Led2_CtrlMode, system-signal=D_Led2_CtrlMode}, {implementation-record-element=D_Led3_CtrlMode, system-signal=D_Led3_CtrlMode}, {implementation-record-element=D_Led4_CtrlMode, system-signal=D_Led4_CtrlMode}, {implementation-record-element=SupD_Checksum_0x304, system-signal=SupD_Checksum_0x304}, {implementation-record-element=SupD_Counter_0x304, system-signal=SupD_Counter_0x304}]}
        {signal-group=SG_Sig_Grp_0x300, type-mapping=sender-rec-record-type-mapping=record-element-mappings=[{implementation-record-element=D_Led1_Control, system-signal=D_Led1_Control}, {implementation-record-element=D_Led2_Control, system-signal=D_Led2_Control}, {implementation-record-element=D_Led3_Control, system-signal=D_Led3_Control}, {implementation-record-element=D_Led4_Control, system-signal=D_Led4_Control}, {implementation-record-element=E2E_Reserve1_0x300, system-signal=E2E_Reserve1_0x300}, {implementation-record-element=E2E_Reserve2_0x300, system-signal=E2E_Reserve2_0x300}, {implementation-record-element=SupD_Checksum_0x300, system-signal=SupD_Checksum_0x300}, {implementation-record-element=SupD_Counter_0x300, system-signal=SupD_Counter_0x300}]}
    root-software-compositions:
      root sw composition prototype EcuSwComposition: software-composition=ECU_Composition
package /ECUCompositionTypes
  composition sw component type ECU_Composition
    component IoHwAb: type=IoHwAb
package /EndToEndProtections
  end to end protection set EndToEndProtectionSet
    end to end protection ECU_Composition_SG_Sig_Grp_0x212_SG_Sig_Grp_0x212: end-to-end-profile={category=PROFILE_01, data-ids=4112, data-id-mode=0, data-length=64, max-delta-counter-init=2, crc-offset=0, counter-offset=56, max-no-new-or-repeated-data=14, sync-counter-init=2, data-id-nibble-offset=0}, end-to-end-protection-variable-prototype=EcuSwComposition
    end to end protection ECU_Composition_SG_Sig_Grp_0x300_SG_Sig_Grp_0x300: end-to-end-profile={category=PROFILE_01, data-ids=8224, data-id-mode=0, data-length=64, max-delta-counter-init=2, crc-offset=0, counter-offset=56, max-no-new-or-repeated-data=14, sync-counter-init=2, data-id-nibble-offset=0}, end-to-end-protection-variable-prototype=receiver=EcuSwComposition
