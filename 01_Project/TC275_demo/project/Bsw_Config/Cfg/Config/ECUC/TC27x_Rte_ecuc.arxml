AUTOSAR XML (schema 00046)
package /ActiveEcuC
  module config Rte: implementation-config-variant=VARIANT-PRE-COMPILE, module-description=Rte_Impl
    RteInitializationBehavior: RteInitializationStrategy=RTE_INITIALIZATION_STRATEGY_AT_DATA_DECLARATION, RteSectionInitializationPolicy=INIT
    RteGeneration:
      RteGenerationMode = COMPATIBILITY_MODE
      RteIocInteractionReturnValue = RTE_IOC
      RteValueRangeCheckEnabled = false
      RteCalibrationSupport = NONE
      RteCodeVendorId = 30
      RteDevErrorDetect = true
      RteDevErrorDetectUninit = false
      RteMeasurementSupport = false
      RteOptimizationMode = MEMORY
      RteVfbTraceEnabled = false
    RteBswGeneral: RteSchMVersionInfoApi=false, RteUseComShadowSignalApi=false
    RteOsInteraction
      3 x RteUsedOsActivation, all with RteExpectedActivationOffset=0, RteExpectedTickDuration=0:
        Rte_Al_TE2_EcuM_EcuM_MainFunction: RteActivationOsAlarmRef=Rte_Al_TE2_EcuM_EcuM_MainFunction, RteActivationOsTaskRef=OsTask_App10ms_Core1
        Rte_Al_TE2_OsTask_App10ms_Core2_0_5ms: RteActivationOsAlarmRef=Rte_Al_TE2_OsTask_App10ms_Core2_0_5ms, RteActivationOsTaskRef=OsTask_App10ms_Core2
        Rte_Al_TE2_OsTask_Bsw5ms_Core0_0_5ms: RteActivationOsAlarmRef=Rte_Al_TE2_OsTask_Bsw5ms_Core0_0_5ms, RteActivationOsTaskRef=OsTask_Bsw5ms_Core0
    4 x RteBswModuleInstance:
      BswM: RteBswImplementationRef=BswM_Impl, RteBswModuleConfigurationRef=BswM
        BSWM_EXCLUSIVE_AREA_0 (RteBswExclusiveAreaImpl): RteExclusiveAreaImplMechanism=ALL_INTERRUPT_BLOCKING, RteBswExclusiveAreaRef=BSWM_EXCLUSIVE_AREA_0
        BswM_MainFunctionTimingEvent0 (RteBswEventToTaskMapping):
          RteBswImmediateRestart = false
          RteBswPositionInTask = 10
          RteBswEventRef = BswM_MainFunctionTimingEvent0
          RteBswMappedToTaskRef = OsTask_Bsw5ms_Core0
          RteBswUsedOsEventRef = Rte_Ev_Cyclic2_OsTask_Bsw5ms_Core0_0_5ms
          RteBswUsedOsAlarmRef = Rte_Al_TE2_OsTask_Bsw5ms_Core0_0_5ms
      Det: RteBswImplementationRef=Det_Impl, RteBswModuleConfigurationRef=Det
        DET_EXCLUSIVE_AREA_0 (RteBswExclusiveAreaImpl): RteExclusiveAreaImplMechanism=ALL_INTERRUPT_BLOCKING, RteBswExclusiveAreaRef=DET_EXCLUSIVE_AREA_0
      EcuM: RteBswImplementationRef=EcuM_Impl, RteBswModuleConfigurationRef=EcuM
        EcuM_MainFunctionTimingEvent0 (RteBswEventToTaskMapping):
          RteBswImmediateRestart = false
          RteBswPositionInTask = 1
          RteBswEventRef = EcuM_MainFunctionTimingEvent0
          RteBswMappedToTaskRef = OsTask_Bsw5ms_Core0
          RteBswUsedOsAlarmRef = Rte_Al_TE2_OsTask_Bsw5ms_Core0_0_5ms
          RteBswUsedOsEventRef = Rte_Ev_Cyclic2_OsTask_Bsw5ms_Core0_0_5ms
        3 x RteBswExclusiveAreaImpl, all with RteExclusiveAreaImplMechanism=ALL_INTERRUPT_BLOCKING:
          ECUM_EXCLUSIVE_AREA_{0..2}: RteBswExclusiveAreaRef=ECUM_EXCLUSIVE_AREA_{0..2}
        EcuM_MainFunctionTimingEvent1 (RteBswEventToTaskMapping):
          RteBswImmediateRestart = false
          RteBswPositionInTask = 1
          RteBswEventRef = EcuM_MainFunctionTimingEvent1
          RteBswMappedToTaskRef = OsTask_App10ms_Core1
          RteBswUsedOsEventRef = Rte_Ev_RunS2_EcuM_EcuM_MainFunction
          RteBswUsedOsAlarmRef = Rte_Al_TE2_EcuM_EcuM_MainFunction
        EcuM_MainFunctionTimingEvent2 (RteBswEventToTaskMapping):
          RteBswImmediateRestart = false
          RteBswPositionInTask = 1
          RteBswEventRef = EcuM_MainFunctionTimingEvent2
          RteBswMappedToTaskRef = OsTask_App10ms_Core2
          RteBswUsedOsEventRef = Rte_Ev_Cyclic2_OsTask_App10ms_Core2_0_5ms
          RteBswUsedOsAlarmRef = Rte_Al_TE2_OsTask_App10ms_Core2_0_5ms
      Rte: RteBswImplementationRef=Rte_Impl, RteBswModuleConfigurationRef=Rte
    6 x RteSwComponentInstance:
      EcuM_EcuSwComposition: RteSoftwareComponentInstanceRef=EcuM
        8 x RteEventToTaskMapping, all with RteImmediateRestart=false:
          Timer_EcuM_MainFunction: RtePositionInTask=1, RteEventRef=Timer_EcuM_MainFunction, RteMappedToTaskRef=OsTask_App10ms_Core2, RteUsedOsEventRef=Rte_Ev_Cyclic2_OsTask_App10ms_Core2_0_5ms, RteUsedOsAlarmRef=Rte_Al_TE2_OsTask_App10ms_Core2_0_5ms
          OpEventSelectShutdownTarget_SelectShutdownTarget_EcuM_ShutdownTarget: RteEventRef=OpEventSelectShutdownTarget_SelectShutdownTarget_EcuM_ShutdownTarget
          OpEventGetShutdownTarget_GetShutdownTarget_EcuM_ShutdownTarget: RteEventRef=OpEventGetShutdownTarget_GetShutdownTarget_EcuM_ShutdownTarget
          OpEventGetLastShutdownTarget_GetLastShutdownTarget_EcuM_ShutdownTarget: RteEventRef=OpEventGetLastShutdownTarget_GetLastShutdownTarget_EcuM_ShutdownTarget
          OpEventSelectShutdownCause_SelectShutdownCause_EcuM_ShutdownTarget: RteEventRef=OpEventSelectShutdownCause_SelectShutdownCause_EcuM_ShutdownTarget
          OpEventGetShutdownCause_GetShutdownCause_EcuM_ShutdownTarget: RteEventRef=OpEventGetShutdownCause_GetShutdownCause_EcuM_ShutdownTarget
          OpEventSelectBootTarget_SelectBootTarget_EcuM_BootTarget: RteEventRef=OpEventSelectBootTarget_SelectBootTarget_EcuM_BootTarget
          OpEventGetBootTarget_GetBootTarget_EcuM_BootTarget: RteEventRef=OpEventGetBootTarget_GetBootTarget_EcuM_BootTarget
      Det_EcuSwComposition: RteSoftwareComponentInstanceRef=Det
        OpEventReportError_ReportError_DetModule (RteEventToTaskMapping): RteImmediateRestart=false, RtePositionInTask=18, RteEventRef=OpEventReportError_ReportError_DetModule, RteMappedToTaskRef=OsTask_Bsw5ms_Core0
      Os_OsCore0_swc_EcuSwComposition: RteSoftwareComponentInstanceRef=Os_OsCore0_swc
        OpEventGetCounterValue_GetCounterValue_OsService_SystemTimer_Core0 (RteEventToTaskMapping):
          RteImmediateRestart = false
          RtePositionInTask = 16
          RteEventRef = OpEventGetCounterValue_GetCounterValue_OsService_SystemTimer_Core0
          RteMappedToTaskRef = OsTask_Bsw5ms_Core0
        OpEventGetElapsedValue_GetElapsedValue_OsService_SystemTimer_Core0 (RteEventToTaskMapping):
          RteImmediateRestart = false
          RtePositionInTask = 17
          RteEventRef = OpEventGetElapsedValue_GetElapsedValue_OsService_SystemTimer_Core0
          RteMappedToTaskRef = OsTask_Bsw5ms_Core0
      Os_OsCore2_swc_EcuSwComposition: RteSoftwareComponentInstanceRef=Os_OsCore2_swc
        OpEventGetCounterValue_GetCounterValue_OsService_SystemTimer_Core2 (RteEventToTaskMapping):
          RteImmediateRestart = false
          RtePositionInTask = 4
          RteEventRef = OpEventGetCounterValue_GetCounterValue_OsService_SystemTimer_Core2
          RteMappedToTaskRef = OsTask_App10ms_Core2
        OpEventGetElapsedValue_GetElapsedValue_OsService_SystemTimer_Core2 (RteEventToTaskMapping):
          RteImmediateRestart = false
          RtePositionInTask = 5
          RteEventRef = OpEventGetElapsedValue_GetElapsedValue_OsService_SystemTimer_Core2
          RteMappedToTaskRef = OsTask_App10ms_Core2
      Os_OsCore1_swc_EcuSwComposition: RteSoftwareComponentInstanceRef=Os_OsCore1_swc
        OpEventGetCounterValue_GetCounterValue_OsService_SystemTimer_Core1 (RteEventToTaskMapping):
          RteImmediateRestart = false
          RtePositionInTask = 2
          RteEventRef = OpEventGetCounterValue_GetCounterValue_OsService_SystemTimer_Core1
          RteMappedToTaskRef = OsTask_App10ms_Core1
        OpEventGetElapsedValue_GetElapsedValue_OsService_SystemTimer_Core1 (RteEventToTaskMapping):
          RteImmediateRestart = false
          RtePositionInTask = 3
          RteEventRef = OpEventGetElapsedValue_GetElapsedValue_OsService_SystemTimer_Core1
          RteMappedToTaskRef = OsTask_App10ms_Core1
      BswM_EcuSwComposition: RteSoftwareComponentInstanceRef=BswM
        Timer_BswM_MainFunction (RteEventToTaskMapping):
          RteImmediateRestart = false
          RtePositionInTask = 10
          RteEventRef = Timer_BswM_MainFunction
          RteMappedToTaskRef = OsTask_Bsw5ms_Core0
          RteUsedOsAlarmRef = Rte_Al_TE2_OsTask_Bsw5ms_Core0_0_5ms
          RteUsedOsEventRef = Rte_Ev_Cyclic2_OsTask_Bsw5ms_Core0_0_5ms
    Mcu (RteBswModuleInstance): RteBswImplementationRef=Mcu_Impl, RteBswModuleConfigurationRef=Mcu
