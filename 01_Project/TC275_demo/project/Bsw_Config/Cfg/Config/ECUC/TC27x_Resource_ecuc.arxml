AUTOSAR XML (schema 00046)
package /Resource
  module config Resource: implementation-config-variant=VARIANT-PRE-COMPILE
    ResourceGeneral: ResourceSubDerivative=TC275TP_64F200W
