AUTOSAR XML (schema 00046)
package /ActiveEcuC
  module config vSet: implementation-config-variant=VARIANT-PRE-COMPILE, module-description=vSet_Impl
    vSetCalibration
    vSetGeneral: vSetDummyStatementKind=None
    vSetPlatform:
      vSetCPUType = CPU32Bit
      vSetBitOrder = LSB_to_MSB
      vSetSizeOfEnum = Size32Bit
      vSetSizeOfRAMPointer = Size32Bit
      vSetSizeOfROMPointer = Size32Bit
      vSetSizeOfInt = Size32Bit
      vSetByteOrder = LITTLE_ENDIAN
