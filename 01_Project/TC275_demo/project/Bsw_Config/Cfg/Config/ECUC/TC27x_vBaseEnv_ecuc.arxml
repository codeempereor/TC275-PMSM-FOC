AUTOSAR XML (schema 00046)
package /ActiveEcuC
  module config vBaseEnv: implementation-config-variant=VARIANT-PRE-COMPILE, module-description=vBaseEnv_Impl
    vBaseEnvGeneral: vBaseEnvTestedDerivativeRef=TC275
      TC237 (vBaseEnvDerivativeInformation):
        vBaseEnvCpuCoreAmount = 1
        vBaseEnvCpuMaxFrequency = 200
        vBaseEnvTestedDerivative = TC23x
        vBaseEnvTestedDerivativeDescription = Infineon Aurix TC23x Family
        vBaseEnvAvailableChannels_Can = 6
        vBaseEnvAvailableChannels_Ethernet = 1
        vBaseEnvAvailableChannels_Flexray = 2
        vBaseEnvAvailableChannels_Lin = 2
        vBaseEnvCpuCore = TC161
        4 x vBaseEnvMemLayoutHwRegion:
          DSPR0: vBaseEnvHwRegionStartAddress=1879048192, vBaseEnvHwRegionSize=188416
          PSPR0: vBaseEnvHwRegionStartAddress=1880096768, vBaseEnvHwRegionSize=8192
          PFlash0_Cached: vBaseEnvHwRegionStartAddress=2147483648, vBaseEnvHwRegionSize=2097152
          PFlash0_NonCached: vBaseEnvHwRegionStartAddress=2684354560, vBaseEnvHwRegionSize=2097152
        vBaseEnvAdditionalParameters: vBaseEnvWatchdogGroup=A, vBaseEnvPllGroup=A, vBaseEnvPortGroup=A, vBaseEnvResetGroup=A, vBaseEnvDerivativeGroup=TC2xx
        5 x vBaseEnvMemLayoutHwRegion, all with vBaseEnvHwRegionSize=32:
          BMHD0: vBaseEnvHwRegionStartAddress=2684354560
          BMHD1: vBaseEnvHwRegionStartAddress=2684485632
          BMHD2: vBaseEnvHwRegionStartAddress=2684420064
          BMHD3: vBaseEnvHwRegionStartAddress=2684485600
          STARTUP: vBaseEnvHwRegionStartAddress=2684354592
      9 x vBaseEnvMemLayoutHwRegion:
        DSPR0
        PSPR0
        PFlash0_Cached
        PFlash0_NonCached
        BMHD{0..3}
        STARTUP
      3 x vBaseEnvDerivativeInformation, all with vBaseEnvCpuMaxFrequency=200, vBaseEnvAvailableChannels_Ethernet=1, vBaseEnvAvailableChannels_Flexray=2, vBaseEnvAvailableChannels_Lin=2, vBaseEnvCpuCore=TC161:
        TC234: vBaseEnvCpuCoreAmount=1, vBaseEnvTestedDerivative=TC23x, vBaseEnvTestedDerivativeDescription=Infineon Aurix TC23x Family, vBaseEnvAvailableChannels_Can=6
          4 x vBaseEnvMemLayoutHwRegion:
            DSPR0: vBaseEnvHwRegionStartAddress=1879048192, vBaseEnvHwRegionSize=188416
            PSPR0: vBaseEnvHwRegionStartAddress=1880096768, vBaseEnvHwRegionSize=8192
            PFlash0_Cached: vBaseEnvHwRegionStartAddress=2147483648, vBaseEnvHwRegionSize=2097152
            PFlash0_NonCached: vBaseEnvHwRegionStartAddress=2684354560, vBaseEnvHwRegionSize=2097152
          vBaseEnvAdditionalParameters: vBaseEnvWatchdogGroup=A, vBaseEnvPllGroup=A, vBaseEnvPortGroup=A, vBaseEnvResetGroup=A, vBaseEnvDerivativeGroup=TC2xx
          5 x vBaseEnvMemLayoutHwRegion, all with vBaseEnvHwRegionSize=32:
            BMHD0: vBaseEnvHwRegionStartAddress=2684354560
            BMHD1: vBaseEnvHwRegionStartAddress=2684485632
            BMHD2: vBaseEnvHwRegionStartAddress=2684420064
            BMHD3: vBaseEnvHwRegionStartAddress=2684485600
            STARTUP: vBaseEnvHwRegionStartAddress=2684354592
        TC233: vBaseEnvCpuCoreAmount=1, vBaseEnvTestedDerivative=TC23x, vBaseEnvTestedDerivativeDescription=Infineon Aurix TC23x Family, vBaseEnvAvailableChannels_Can=6
          4 x vBaseEnvMemLayoutHwRegion:
            DSPR0: vBaseEnvHwRegionStartAddress=1879048192, vBaseEnvHwRegionSize=188416
            PSPR0: vBaseEnvHwRegionStartAddress=1880096768, vBaseEnvHwRegionSize=8192
            PFlash0_Cached: vBaseEnvHwRegionStartAddress=2147483648, vBaseEnvHwRegionSize=2097152
            PFlash0_NonCached: vBaseEnvHwRegionStartAddress=2684354560, vBaseEnvHwRegionSize=2097152
          vBaseEnvAdditionalParameters: vBaseEnvWatchdogGroup=A, vBaseEnvPllGroup=A, vBaseEnvPortGroup=A, vBaseEnvResetGroup=A, vBaseEnvDerivativeGroup=TC2xx
          5 x vBaseEnvMemLayoutHwRegion, all with vBaseEnvHwRegionSize=32:
            BMHD0: vBaseEnvHwRegionStartAddress=2684354560
            BMHD1: vBaseEnvHwRegionStartAddress=2684485632
            BMHD2: vBaseEnvHwRegionStartAddress=2684420064
            BMHD3: vBaseEnvHwRegionStartAddress=2684485600
            STARTUP: vBaseEnvHwRegionStartAddress=2684354592
        TC275: vBaseEnvCpuCoreAmount=3, vBaseEnvTestedDerivative=TC27x, vBaseEnvTestedDerivativeDescription=Infineon Aurix TC27x Family, vBaseEnvAvailableChannels_Can=4
          4 x vBaseEnvMemLayoutHwRegion:
            DSPR0: vBaseEnvHwRegionStartAddress=1879048192, vBaseEnvHwRegionSize=114688
            PSPR0: vBaseEnvHwRegionStartAddress=1880096768, vBaseEnvHwRegionSize=24576
            PFlash0_Cached: vBaseEnvHwRegionStartAddress=2147483648, vBaseEnvHwRegionSize=2097152
            PFlash0_NonCached: vBaseEnvHwRegionStartAddress=2684354560, vBaseEnvHwRegionSize=2097152
          vBaseEnvAdditionalParameters: vBaseEnvWatchdogGroup=A, vBaseEnvPllGroup=A, vBaseEnvPortGroup=A, vBaseEnvResetGroup=A, vBaseEnvDerivativeGroup=TC2xx
          13 x vBaseEnvMemLayoutHwRegion:
            BMHD0: vBaseEnvHwRegionStartAddress=2684354560, vBaseEnvHwRegionSize=32
            BMHD1: vBaseEnvHwRegionStartAddress=2684485632, vBaseEnvHwRegionSize=32
            BMHD2: vBaseEnvHwRegionStartAddress=2684420064, vBaseEnvHwRegionSize=32
            BMHD3: vBaseEnvHwRegionStartAddress=2684485600, vBaseEnvHwRegionSize=32
            STARTUP: vBaseEnvHwRegionSize=32, vBaseEnvHwRegionStartAddress=2684354592
            PFlash1_Cached: vBaseEnvHwRegionStartAddress=2149580800, vBaseEnvHwRegionSize=2097152
            PFlash1_NonCached: vBaseEnvHwRegionStartAddress=2686451712, vBaseEnvHwRegionSize=2097152
            DSPR1: vBaseEnvHwRegionStartAddress=1610612736, vBaseEnvHwRegionSize=122880
            DSPR2: vBaseEnvHwRegionStartAddress=1342177280, vBaseEnvHwRegionSize=122880
            PSPR1: vBaseEnvHwRegionStartAddress=1611661312, vBaseEnvHwRegionSize=32768
            PSPR2: vBaseEnvHwRegionStartAddress=1343225856, vBaseEnvHwRegionSize=32768
            lmuram_Cahed: vBaseEnvHwRegionStartAddress=2415919104, vBaseEnvHwRegionSize=32768
            lmuram_NonCahed: vBaseEnvHwRegionStartAddress=2952790016, vBaseEnvHwRegionSize=32768
      8 x vBaseEnvMemLayoutHwRegion:
        DSPR1
        DSPR2
        PSPR1
        PSPR2
        PFlash1_Cached
        PFlash1_NonCached
        lmuram_Cahed
        lmuram_NonCahed
