AUTOSAR XML (schema 00046)
package /ActiveEcuC
  module config vBRS: implementation-config-variant=VARIANT-PRE-COMPILE, module-description=vBRS_Impl
    vBRSHwConfig:
      vBRSOscClock = 20000000
      vBRSPeriphClock = 80000000
      vBRSTimebaseClock = 200
      vBRSPeriphClockDescription = Initial value for Peripheral Clock: 50MHz GPT= 50Hz/8
      vBRSEnablePortHandling = false
      vBRSEnableWatchdogHandling = false
      vBRSEnablePLLClocksHandling = false
      7 x vBRSEvalBoardInfo, all with vBRSEvalBoardOscClock=20000000:
        TRIBOARD_TC2x7: vBRSEvalBoard=TRIBOARD_TC2x7, vBRSEvalBoardDescription=Toggle Port Group 33 Port 6 for LED support
        TRIBOARD_TC2x5: vBRSEvalBoard=TRIBOARD_TC2x5, vBRSEvalBoardDescription=Toggle Port Group 33 Port 6 for LED support
        TRIBOARD_TC2x2: vBRSEvalBoard=TRIBOARD_TC2x2, vBRSEvalBoardDescription=Toggle Port Group 2 Port 0 for LED support
        TRIBOARD_TC2x3: vBRSEvalBoard=TRIBOARD_TC2x3, vBRSEvalBoardDescription=Toggle Port Group 11 Port 8 for LED support
        TRIBOARD_TC2x4: vBRSEvalBoard=TRIBOARD_TC2x4, vBRSEvalBoardDescription=Toggle Port Group 33 Port 6 for LED support
        TRIBOARD_TC2x8: vBRSEvalBoard=TRIBOARD_TC2x8, vBRSEvalBoardDescription=Toggle Port Group 33 Port 6 for LED support
        TRIBOARD_TC2x9: vBRSEvalBoard=TRIBOARD_TC2x9, vBRSEvalBoardDescription=Toggle Port Group 33 Port 6 for LED support
    vBRSGeneral:
      vBRSEnableSupportLEDs = false
      vBRSEnableSafeContextSupport = false
      vBRSEnableMultiCoreSupport = true
      vBRSEnableSupportToggleWdPin = false
      vBRSEnableSupportToggleCustomPin = false
      vBRSEnableEcuMStubGeneration = false
      vBRSDisableSetupSupport = false
      vBRSEnableSchmStubGeneration = false
      vBRSEnableSchmStubSupportDrvCanAN = true
      vBRSFblSupport = Disabled
    vBRSMemoryInit: vBRSInitPatternBlocks=0, vBRSInitPatternHardResetBlocks=0, vBRSInitPatternAreas=0, vBRSInitPatternHardResetAreas=0
