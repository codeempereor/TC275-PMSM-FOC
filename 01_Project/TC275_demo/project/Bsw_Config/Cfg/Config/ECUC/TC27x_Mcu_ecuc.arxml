AUTOSAR XML (schema 00046)
package /Mcu
  module config Mcu: implementation-config-variant=VARIANT-POST-BUILD-LOADABLE, module-description=Mcu_Impl
    McuPublishedInformation
      18 x McuResetReasonConf:
        MCU_CB0_RESET: McuResetReason=8
        MCU_CB1_RESET: McuResetReason=9
        MCU_CB3_RESET: McuResetReason=10
        MCU_ESR0_RESET: McuResetReason=0
        MCU_ESR1_RESET: McuResetReason=1
        MCU_EVR13_RESET: McuResetReason=12
        MCU_EVR33_RESET: McuResetReason=13
        MCU_POWER_ON_RESET: McuResetReason=7
        MCU_RESET_MULTIPLE: McuResetReason=254
        MCU_RESET_UNDEFINED: McuResetReason=255
        MCU_SMU_RESET: McuResetReason=2
        MCU_STBYR_RESET: McuResetReason=15
        MCU_STM0_RESET: McuResetReason=4
        MCU_STM1_RESET: McuResetReason=5
        MCU_STM2_RESET: McuResetReason=6
        MCU_SUPPLY_WDOG_RESET: McuResetReason=14
        MCU_SW_RESET: McuResetReason=3
        MCU_TP_RESET: McuResetReason=11
    McuGeneralConfiguration:
      McuClearColdResetApi = false
      McuDeInitApi = false
      McuDevErrorDetect = false
      McuErayPllDisable = false
      McuErayPllInitDelay = 10
      McuFmPllEnable = false
      McuGetRamStateApi = false
      McuIdleModeCpuCore = INDIVIDUAL_CORES
      McuInitClock = true
      McuMainOscillatorFrequency = 20
      McuNoPll = false
      McuPBFixedAddress = false
      McuPerformResetApi = true
      McuPllInitDelay = 10
      McuResetSfrAtInit = false
      McuRunningInUser0Mode = false
      McuSystemModeCpuCore = CPU_CORE_0
      McuUserModeDeInitApiEnable = false
      McuUserModeInitApiEnable = false
      McuUserModeRuntimeApiEnable = false
      McuVersionInfoApi = false
    McuModuleConfiguration_0 (McuModuleConfiguration):
      McuClockSrcFailureNotification = DISABLED
      McuNumberOfMcuModes = 1
      McuRamSectors = 0
      McuResetSetting = 2
      McuStm{0..2}ResetDisable = false
      McuClockSettingConfig_0 (McuClockSettingConfig): McuClockSettingId=0
        McuClockReferencePoint:
          McuASCLINFDivider = 2
          McuASCLINSDivider = 2
          McuBAUD1Divider = 2
          McuBAUD2Divider = 2
          McuBBBDivider = 2
          McuCANDivider = 2
          McuCPU{0..2}Divider = 0
          McuClockASCLINFFrequency = 80000000
          McuClockASCLINSFrequency = 80000000
          McuClockBAUD1Frequency = 80000000
          McuClockBAUD2Frequency = 80000000
          McuClockBBBFrequency = 80000000
          McuClockCANFrequency = 80000000
          McuClockCPU{0..2}Frequency = 160000000
          McuClockErayFrequency = 80000000
          McuClockErayPll2Frequency = 96000000
          McuClockErayPllFrequency = 160000000
          McuClockFSI2Frequency = 160000000
          McuClockFSIFrequency = 80000000
          McuClockGTMFrequency = 80000000
          McuClockMAXFrequency = 160000000
          McuClockReferencePoint2Frequency = 96000000
          McuClockReferencePointFrequency = 160000000
          McuClockSPBFrequency = 80000000
          McuClockSRIFrequency = 160000000
          McuClockSTMFrequency = 80000000
          McuClockSettingMode = NORMAL_MODE
          McuETHDivider = 1
          McuETHFrequency = 40000000
          McuErayDivider = 2
          McuErayPllK2Divider = 2
          McuErayPllK3Divider = 4
          McuErayPllNDivider = 23
          McuErayPllPDivider = 0
          McuFMPllModAmp = 1.25
          McuFSI2Divider = 1
          McuFSIDivider = 2
          McuGTMDivider = 2
          McuK2DivRampToBackUpConfDelay = 10
          McuK2DivRampToPllConfDelay = 10
          McuK2DivSteps = 4
          McuMAXDivider = 1
          McuPllK1Divider = 1
          McuPllK2Divider = 2
          McuPllK3Divider = 4
          McuPllNDivider = 23
          McuPllPDivider = 0
          McuSPBDivider = 2
          McuSRIDivider = 1
          McuSTMDivider = 2
      McuModeSettingConf_0 (McuModeSettingConf): McuIdleReqAckSeqDisable=false, McuMode=0
        McuStandbySettingConf:
          McuESR0TristateEnable = false
          McuESR1DigitalFilterEnable = false
          McuESR1EdgeDetection = TRIGGER_ANY_EDGE
          McuESR1WakeUpEnable = false
          McuExtSupplyBlankingFilterDelay = T2_5MS
          McuPORSTDigitalFilterEnable = false
          McuPinADigitalFilterEnable = false
          McuPinAEdgeDetection = TRIGGER_ANY_EDGE
          McuPinAWakeUpEnable = false
          McuPinBDigitalFilterEnable = false
          McuPinBEdgeDetection = TRIGGER_ANY_EDGE
          McuPinBWakeUpEnable = false
          McuRARCrcCheckEnable = false
          McuRampToBackupFreqApi = false
          McuSetStandbyWakeupControlApi = false
          McuStandbyRAMSupplyEnable = true
          McuTristateEnable = false
          McuWakeupOnExtSupplyRampUpEnable = false
      McuTriggerReset: ESR0ResetTrigger=0, ESR1ResetTrigger=0, SMUResetTrigger=1, STM0ResetTrigger=0, STM1ResetTrigger=0, STM2ResetTrigger=0
      AscLinConfiguration: AscLin0=USE_FOR_NONE, AscLin1=USE_FOR_NONE, AscLin2=USE_FOR_NONE, AscLin3=USE_FOR_NONE
    McuSafety: McuClockMonitoringEnable=true, McuGetModeApi=true, McuInitCheckApi=true, McuSafetyEnable=false
    CommonPublishedInformation:
      ArMajorVersion = 3
      ArMinorVersion = 2
      ArPatchVersion = 0
      ModuleId = 101
      Release = _TRICORE_TC275
      SwMajorVersion = 4
      SwMinorVersion = 9
      SwPatchVersion = 1
      VendorId = 17
