AUTOSAR XML (schema 00046)
package /ActiveEcuC
  module config BswM: implementation-config-variant=VARIANT-PRE-COMPILE, module-description=BswM_Impl
    BswMConfig
      BswMArbitration
      BswMModeControl
      BswMDataTypeMappingSets: BswMDataTypeMappingSetRef=BswMMappingSet
      4 x BswMRteModeDclGroup:
        ESH_Mode: BswMInitMode=STARTUP
          5 x BswMRteMode:
            STARTUP: BswMModePhysicalValue=0
            RUN: BswMModePhysicalValue=1
            POSTRUN: BswMModePhysicalValue=2
            WAKEUP: BswMModePhysicalValue=3
            SHUTDOWN: BswMModePhysicalValue=4
        ESH_RunRequest: BswMInitMode=RELEASED
          RELEASED (BswMRteMode): BswMModePhysicalValue=0
          REQUESTED (BswMRteMode): BswMModePhysicalValue=1
        ModeDecl_ComFault_State: BswMInitMode=ComFaultPreCond_FAIL
          ComFaultPreCond_PASS (BswMRteMode): BswMModePhysicalValue=1
          ComFaultPreCond_FAIL (BswMRteMode): BswMModePhysicalValue=0
        ModeDecl_ComFault_State_WithKL15: BswMInitMode=ComFaultPreCondWithKL15_FAIL
          ComFaultPreCondWithKL15_FAIL (BswMRteMode): BswMModePhysicalValue=0
          ComFaultPreCondWithKL15_PASS (BswMRteMode): BswMModePhysicalValue=1
    BswMGeneral:
      BswMCanSMEnabled = false
      BswMComMEnabled = false
      BswMDcmEnabled = false
      BswMDevErrorDetect = true
      BswMEcuMEnabled = true
      BswMEthIfEnabled = false
      BswMEthSMEnabled = false
      BswMFrSMEnabled = false
      BswMGenericRequestEnabled = true
      BswMJ1939DcmEnabled = false
      BswMJ1939NmEnabled = false
      BswMLinSMEnabled = false
      BswMLinTPEnabled = false
      BswMNmEnabled = false
      BswMNvMEnabled = false
      BswMPduREnabled = false
      BswMRuleControlEnabled = false
      BswMSdEnabled = false
      BswMVersionInfoApi = false
      BswMWdgMEnabled = false
      BswMModeCheck = true
      BswMActionListQueueSearchAlgorithm = LINEAR_SEARCH
      BswMSafeBswChecks = false
      BswMMainFunctionPeriod = 0.005
      BswMCommonData
      BswMGeneration:
        BswMOutOfBoundsWriteSanitizer = false
        BswMOutOfBoundsReadSanitizer = false
        BswMReduceConstantData2Define = true
        BswMBoolDataInArrayOfStructStrategy = BITMASKING
        BswMInterfacesForDeactivatedData = false
